// Copyright 2022 Manna Harbour
// https://github.com/manna-harbour/miryoku

#define MIRYOKU_DOUBLE_TAP_GUARD(NAME, BINDING) \
/ { \
  behaviors { \
    NAME: NAME { \
      compatible = "zmk,behavior-tap-dance"; \
      #binding-cells = <0>; \
      tapping-term-ms = <U_TAPPING_TERM>; \
      bindings = <&none>, <BINDING>; \
    }; \
  }; \
};

/ {
  behaviors {
    dt_molock: dt_molock {
      compatible = "zmk,behavior-tap-dance";
      label = "dt_molock";
      #binding-cells = <0>;
      tapping-term-ms = <U_TAPPING_TERM>;
      bindings = <&none>, <&molock 0>;
    };
  };
};

/ {
  behaviors {
    tt_btclearall: tt_btclearall {
      compatible = "zmk,behavior-tap-dance";
      label = "tt_btclearall";
      #binding-cells = <0>;
      tapping-term-ms = <U_TAPPING_TERM>;
      bindings = <&none>, <&none>, <&bt BT_CLR_ALL>;
    };
  };
};

#define MIRYOKU_X(LAYER, STRING) \
MIRYOKU_DOUBLE_TAP_GUARD(u_to_U_##LAYER, &to U_##LAYER)
MIRYOKU_LAYER_LIST
#undef MIRYOKU_X

#if defined (MIRYOKU_KLUDGE_DOUBLETAPBOOT)
  #if defined (MIRYOKU_KLUDGE_SOFT_OFF)
MIRYOKU_DOUBLE_TAP_GUARD(u_soft_off, &soft_off)
  #else
MIRYOKU_DOUBLE_TAP_GUARD(u_bootloader, &bootloader)
  #endif
#endif
