// Copyright 2021 Manna Harbour
// https://github.com/manna-harbour/miryoku

#define EYELASH_CORNE

#include "../miryoku/custom_config.h"
#include "../miryoku/mapping/42/eyelash_corne.h"
#include "../miryoku/miryoku.dtsi"
